/* 4 MB flash: 1 MB code and 3 MB storage; settings use the first storage sector. */
#include <raspberrypi/partitions_4M_storage.dtsi>

/ {
	chosen {
		zephyr,code-partition = &code_partition;
	};
};

/* 150 MHz system clock divided by four. */
&zephyrforge_sd {
	max-bus-freq = <37500000>;
};
