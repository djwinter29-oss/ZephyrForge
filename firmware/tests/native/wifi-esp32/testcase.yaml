## firmware/tests/native/wifi-esp32/testcase.yaml
```yaml
tests:
  zephyrforge.wifi.esp32_lifecycle:
    platform_allow:
      - native_sim/native/64
    tags:
      - wifi
```

## firmware/tests/native/wifi-recovery/testcase.yaml
```yaml
tests:
  zephyrforge.wifi.recovery:
    platform_allow:
      - native_sim/native/64
    tags:
      - wifi
```

## firmware/tests/wifi/native/testcase.yaml
```yaml
tests:
  zephyrforge.wifi.blocking_driver:
    platform_allow:
      - native_sim/native/64
    tags:
      - wifi
```

## west.yml
```yaml
manifest:
  version: "1.2"
  projects:
    - name: zephyr
      url: https://github.com/zephyrproject-rtos/zephyr
      revision: v4.3.2
      import:
        name-allowlist:
          - hal_espressif
          - hal_rpi_pico
          - hal_infineon
          - cmsis_6
          - fatfs
          - mbedtls
  self:
    path: zephyrforge
```
